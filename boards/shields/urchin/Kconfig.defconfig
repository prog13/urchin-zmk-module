## boards/shields/urchin/Kconfig.defconfig
```kconfig
# Copyright (c) 2022 Duccio Breschi
# SPDX-License-Identifier: MIT

if SHIELD_URCHIN_DONGLE

config ZMK_KEYBOARD_NAME
    default "urchin"

config ZMK_SPLIT
    default y

config ZMK_SPLIT_ROLE_CENTRAL
    default y

# https://zmk.dev/docs/config/split#kconfig
config ZMK_SPLIT_PERIPHERAL_HID_INDICATORS
    default y

config ZMK_SPLIT_BLE_CENTRAL_PERIPHERALS
    default 2

config ZMK_USB
    default y

# https://zmk.dev/docs/config/power#idlesleep
config ZMK_SLEEP
    default n

# https://zmk.dev/docs/config/bluetooth#kconfig
config ZMK_BLE_EXPERIMENTAL_FEATURES
    default y

endif

if SHIELD_URCHIN_LEFT

config ZMK_KEYBOARD_NAME
    default "urchin"

config ZMK_SPLIT_ROLE_CENTRAL
    default y

endif

if SHIELD_URCHIN_LEFT || SHIELD_URCHIN_RIGHT
config ZMK_SPLIT
    default y
endif
```
